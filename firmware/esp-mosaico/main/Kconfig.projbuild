## firmware/esp-mosaico/main/Kconfig.projbuild
```kconfig
menu "Bansayo tracker"
    config BANSAYO_WIFI_SSID
        string "Wi-Fi SSID"
        default ""
    config BANSAYO_WIFI_PASSWORD
        string "Wi-Fi password (WPA2 or newer)"
        default ""
    config BANSAYO_SERVER_IP
        string "Bansayo PC IPv4 address"
        default ""
    config BANSAYO_SERVER_PORT
        int "BIMU UDP port"
        range 1 65535
        default 7710
    choice BANSAYO_RATE
        prompt "IMU sample rate"
        default BANSAYO_RATE_200
        config BANSAYO_RATE_100
            bool "100 Hz"
        config BANSAYO_RATE_200
            bool "200 Hz"
    endchoice
    config BANSAYO_CALIBRATION_SECONDS
        int "Stationary startup calibration duration (seconds)"
        range 1 10
        default 2
    config BANSAYO_AHRS_GAIN_MILLI
        int "Gravity correction gain (x1000)"
        range 0 5000
        default 1000
    config BANSAYO_DISPLAY
        bool "Enable local diagnostic screen"
        default y
    config BANSAYO_MAG_DIAGNOSTICS
        bool "Stream both magnetometers for live diagnostics"
        default y
endmenu
```
